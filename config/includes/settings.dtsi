// Make sure this file is included before all other files

/*
 * Layer Tap Config
 */
&lt {  // layer-tap config
  flavor = "balanced";
  tapping-term-ms = <200>;
  quick-tap-ms = <175>;
};

/*
 * Caps Word Settings
 */
&caps_word {
    // Allow caps word to continue even when minus or underscore
    // are pressed.
    // Also prevent mod presses from cancelling caps word.
    continue-list = <
      UNDERSCORE MINUS
      //LCTRL LALT LGUI LSHFT
      LCTRL LALT LGUI 
      //RCTRL RALT RGUI RSHFT
      RCTRL RALT RGUI 
      BACKSPACE
    >;
    #ifdef HAS_UROB
        /delete-property/ ignore-modifiers;
    #endif
};

#ifdef HAS_CAPSLOCK
    &caps_word_capslock {
        disable-on-keys = <
            SPACE TAB ENTER ESCAPE
            COMMA DOT SEMI COLON QUESTION EXCLAMATION
            SLASH BACKSLASH SINGLE_QUOTE DOUBLE_QUOTES GRAVE
            LPAR RPAR LBKT RBKT LBRC RBRC LT GT
        >;
    };
#endif

#ifdef HAS_UROB
    &num_word {
        layers = <NUM_WORD>;
        continue-list = <
            BACKSPACE DELETE DOT COMMA
            SLASH ASTERISK PLUS MINUS EQUAL DOLLAR
            RS(SPACE)
        >;
        ignore-modifiers;  // modifiers don't deactivate the layer
    };
#endif
